// SPDX-License-Identifier: BSD-3-Clause
/*
 * Copyright (c) 2025 Dale Whinham <daleyo@gmail.com>
 */

/dts-v1/;

#include "hamoa.dtsi"
#include "x1-microsoft-denali.dtsi"

/ {
	model = "Microsoft Surface Pro 11th Edition (LCD)";
	compatible = "microsoft,denali-lcd", "microsoft,denali",
		     "lenovo,thinkpad-t14s",
		     "qcom,x1p64100", "qcom,x1e80100";
};

&gpu_zap_shader {
	memory-region = <&gpu_microcode_mem>;
	firmware-name = "qcom/x1e80100/microsoft/Denali/qcdxkmsuc8380.mbn";
};

&remoteproc_adsp {
	firmware-name = "qcom/x1e80100/microsoft/Denali/qcadsp8380.mbn",
			"qcom/x1e80100/microsoft/Denali/adsp_dtb.mbn";

	status = "okay";
};

&remoteproc_cdsp {
	firmware-name = "qcom/x1e80100/microsoft/Denali/qccdsp8380.mbn",
			"qcom/x1e80100/microsoft/Denali/cdsp_dtb.mbn";

	status = "okay";
};
