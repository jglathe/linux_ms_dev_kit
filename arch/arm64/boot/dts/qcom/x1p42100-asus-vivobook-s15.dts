// SPDX-License-Identifier: BSD-3-Clause
/*
 * Copyright (c) 2023 Qualcomm Innovation Center, Inc. All rights reserved.
 * Copyright (c) 2024, Xilin Wu <wuxilin123@gmail.com>
 */

/dts-v1/;

#include "purwa.dtsi"
#include "x1-asus-vivobook-s15.dtsi"

/delete-node/ &pmc8380_6;
/delete-node/ &pmc8380_6_thermal;

/ {
	model = "ASUS Vivobook S 15 X1P-42-100";
	compatible = "asus,vivobook-s15-x1p4", "lenovo,thinkpad-t14s", "qcom,x1p42100";
	chassis-type = "laptop";
};

&gpu {
	status = "okay";
};

&gpu_zap_shader {
	firmware-name = "qcom/x1e80100/ASUSTeK/vivobook-s15/qcdxkmsucpurwa.mbn";
};
