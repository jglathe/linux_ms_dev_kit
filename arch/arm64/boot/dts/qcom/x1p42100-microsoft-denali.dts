// SPDX-License-Identifier: BSD-3-Clause
/*
 * Copyright (c) 2025 Dale Whinham <daleyo@gmail.com>
 * Copyright (c) 2026 Jens Glathe <jens.glathe@oldschoolsolutions.biz>
 */

/dts-v1/;

#include "purwa.dtsi"
#include "x1-microsoft-denali.dtsi"

/ {
	model = "Microsoft Surface Pro 11th Edition (LCD, X1P-42-100)";
	compatible = "microsoft,denali-lcd-x1p4", "microsoft,denali",
		     "lenovo,thinkpad-t14s",
		     "qcom,x1p42100";
};

&gpu_zap_shader {
	memory-region = <&gpu_microcode_mem>;
	firmware-name = "qcom/x1p42100/microsoft/Denali/qcdxkmsucpurwa.mbn";
};

&remoteproc_adsp {
	firmware-name = "qcom/x1p42100/microsoft/Denali/qcadsp8380.mbn",
			"qcom/x1p42100/microsoft/Denali/adsp_dtb.mbn";

	status = "okay";
};

&remoteproc_cdsp {
	firmware-name = "qcom/x1p42100/microsoft/Denali/qccdsp8380.mbn",
			"qcom/x1p42100/microsoft/Denali/cdsp_dtb.mbn";

	status = "okay";
};


