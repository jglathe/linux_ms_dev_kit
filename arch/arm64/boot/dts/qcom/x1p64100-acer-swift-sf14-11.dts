// SPDX-License-Identifier: BSD-3-Clause
/*
* Copyright (c) 2023 Qualcomm Innovation Center, Inc. All rights reserved.
* Copyright (c) 2024, Linaro Limited
*/

/dts-v1/;

#include <dt-bindings/gpio/gpio.h>
#include <dt-bindings/input/gpio-keys.h>
#include <dt-bindings/input/input.h>
#include <dt-bindings/regulator/qcom,rpmh-regulator.h>
#include <dt-bindings/pinctrl/qcom,pmic-gpio.h>

#include "x1-acer-swift-ai.dtsi"

/ {
   model = "Acer Swift 14 AI (SF14-11)";  
   compatible = "acer,swift-sf14-11","lenovo,thinkpad-t14s", "qcom,x1p64100", "qcom,x1e78100", "qcom,x1e80100";
	chassis-type = "laptop";

};

&gpu {
	status = "okay";

	zap-shader {
		firmware-name = "qcom/x1e80100/ACER/SF14-11/qcdxkmsuc8380.mbn";
	};
};


