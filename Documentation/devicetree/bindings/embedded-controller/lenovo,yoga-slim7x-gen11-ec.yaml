## Documentation/devicetree/bindings/embedded-controller/lenovo,yoga-slim7x-gen11-ec.yaml
```yaml
# SPDX-License-Identifier: (GPL-2.0-only OR BSD-2-Clause)
%YAML 1.2
---
$id: http://devicetree.org/schemas/embedded-controller/lenovo,yoga-slim7x-gen11-ec.yaml#
$schema: http://devicetree.org/meta-schemas/core.yaml#

title: Lenovo Yoga Slim 7x Gen 11 Embedded Controller

maintainers:
  - Oleg Keri <okerixx@gmail.com>

description:
  The Lenovo Yoga Slim 7x Gen 11, a Qualcomm Snapdragon X2 Elite (glymur)
  laptop, has a Compal embedded controller on I2C. It reports board
  thermistors, battery cell voltages and CPU fan speed, and drives the
  keyboard backlight.

  This controller is not the Qualcomm reference EC that the Snapdragon
  reference designs place at address 0x76; it speaks a different command
  set and answers at 0x70.

properties:
  compatible:
    const: lenovo,yoga-slim7x-gen11-ec

  reg:
    const: 0x70

  interrupts:
    maxItems: 1
    description:
      The controller pulses this line while it has events queued.

required:
  - compatible
  - reg
  - interrupts

additionalProperties: false

examples:
  - |
    #include <dt-bindings/interrupt-controller/irq.h>

    i2c {
        #address-cells = <1>;
        #size-cells = <0>;

        embedded-controller@70 {
            compatible = "lenovo,yoga-slim7x-gen11-ec";
            reg = <0x70>;

            interrupts-extended = <&tlmm 66 IRQ_TYPE_EDGE_FALLING>;
        };
    };
...
```

## Documentation/devicetree/bindings/hwmon/lenovo,thinkpad-t14s-fan-controller.yaml
```yaml
# SPDX-License-Identifier: (GPL-2.0-only OR BSD-2-Clause)
%YAML 1.2
---
$id: http://devicetree.org/schemas/hwmon/lenovo,thinkpad-t14s-fan-controller.yaml#
$schema: http://devicetree.org/meta-schemas/core.yaml#

title: Lenovo Thinkpad T14s Fan Controller

maintainers:
  - Sebastian Reichel <sre@kernel.org>

description:
  The Qualcomm Snapdragon-based Lenovo Thinkpad T14s has a custom Fan Controller,
  which is not part of the Embedded Controller.

properties:
  compatible:
    const: lenovo,thinkpad-t14s-fan-controller

  reg:
    const: 0x36

required:
  - compatible
  - reg

additionalProperties: false

examples:
  - |+
    i2c {
        #address-cells = <1>;
        #size-cells = <0>;

        fan-controller@36 {
            compatible = "lenovo,thinkpad-t14s-fan-controller";
            reg = <0x36>;
        };
    };
...
```

## Documentation/devicetree/bindings/input/touchscreen/microsoft,mshw0485.yaml
```yaml
# SPDX-License-Identifier: (GPL-2.0-only OR BSD-2-Clause)
%YAML 1.2
---
$id: http://devicetree.org/schemas/input/touchscreen/microsoft,mshw0485.yaml#
$schema: http://devicetree.org/meta-schemas/core.yaml#

title: Microsoft Surface G6 MSHW0485 touchscreen

maintainers:
  - Leon Silcott <leon@boasi.io>

description:
  The MSHW0485 is a HID-over-SPI touchscreen used by the Microsoft Surface
  Pro 11. It uses a protocol-9 Qualcomm GENI controller in quad-SPI mode.

allOf:
  - $ref: touchscreen.yaml#
  - $ref: /schemas/spi/spi-peripheral-props.yaml#

properties:
  compatible:
    const: microsoft,mshw0485

  reg:
    maxItems: 1

  interrupts:
    maxItems: 1

  interrupt-gpios:
    maxItems: 1

  power-gpios:
    maxItems: 1

  reset-gpios:
    maxItems: 1

  microsoft,enable-heat-frame-abi:
    type: boolean
    description:
      Opt in to the optional raw heat-frame misc-device ABI. The matching
      kernel configuration must also be enabled.

  microsoft,enable-iptsd-bridge:
    type: boolean
    description:
      Opt in to the optional HIDRAW-only DFT bridge used by iptsd. The
      matching kernel configuration must also be enabled.

  spi-max-frequency:
    maximum: 40000000

required:
  - compatible
  - reg
  - interrupts
  - interrupt-gpios
  - power-gpios
  - reset-gpios
  - spi-max-frequency

additionalProperties: false

examples:
  - |
    #include <dt-bindings/gpio/gpio.h>
    #include <dt-bindings/interrupt-controller/irq.h>

    spi {
        #address-cells = <1>;
        #size-cells = <0>;

        touchscreen@0 {
            compatible = "microsoft,mshw0485";
            reg = <0>;
            spi-max-frequency = <40000000>;

            interrupt-parent = <&tlmm>;
            interrupts = <51 IRQ_TYPE_LEVEL_LOW>;
            interrupt-gpios = <&tlmm 51 GPIO_ACTIVE_LOW>;
            power-gpios = <&tlmm 64 GPIO_ACTIVE_HIGH>;
            reset-gpios = <&tlmm 48 GPIO_ACTIVE_HIGH>;

            microsoft,enable-heat-frame-abi;
            microsoft,enable-iptsd-bridge;
        };
    };
...
```

## Documentation/devicetree/bindings/interrupt-controller/gpio-irq-mux.yaml
```yaml
# SPDX-License-Identifier: (GPL-2.0 OR BSD-2-Clause)
%YAML 1.2
---
$id: http://devicetree.org/schemas/interrupt-controller/gpio-irq-mux.yaml#
$schema: http://devicetree.org/meta-schemas/core.yaml#

title: GPIO IRQ multiplexer

maintainers:
  - name: Jens Glathe

properties:
  compatible:
    const: gpio-irq-mux

  interrupts:
    maxItems: 1

  interrupt-parent: true

  interrupt-controller: true

  '#interrupt-cells':
    const: 1

  num-interrupts:
    $ref: /schemas/types.yaml#/definitions/uint32
    minimum: 1
    description: Number of child interrupts exposed by the mux.

required:
  - compatible
  - interrupts
  - interrupt-parent
  - interrupt-controller
  - '#interrupt-cells'
  - num-interrupts

additionalProperties: false

examples:
  - |
    irq-mux {
        compatible = "gpio-irq-mux";
        interrupt-parent = <&tlmm>;
        interrupts = <67 IRQ_TYPE_LEVEL_LOW>;
        interrupt-controller;
        #interrupt-cells = <1>;
        num-interrupts = <2>;
    };
```

## Documentation/devicetree/bindings/media/i2c/sony,imx681.yaml
```yaml
# SPDX-License-Identifier: (GPL-2.0-only OR BSD-2-Clause)
%YAML 1.2
---
$id: http://devicetree.org/schemas/media/i2c/sony,imx681.yaml#
$schema: http://devicetree.org/meta-schemas/core.yaml#

title: Sony IMX681 CMOS Image Sensor

maintainers:
  - turbinebmw <turbine.bmw@gmail.com>

description:
  The Sony IMX681 is a CMOS image sensor. The currently supported mode is
  3840x2640 RAW10 at approximately 30 frames per second over one MIPI CSI-2
  C-PHY trio at 2406 Msymbol/s.

allOf:
  - $ref: /schemas/media/video-interface-devices.yaml#

properties:
  compatible:
    const: sony,imx681

  reg:
    maxItems: 1

  clocks:
    description: Input clock at 19.2 MHz
    maxItems: 1

  avdd-supply:
    description: Analog power supply

  dovdd-supply:
    description: Digital I/O power supply

  reset-gpios:
    description: Active-low sensor reset (XCLR) GPIO
    maxItems: 1

  leds: true
  led-names: true
  orientation: true
  rotation: true

  port:
    $ref: /schemas/graph.yaml#/$defs/port-base
    additionalProperties: false

    properties:
      endpoint:
        $ref: /schemas/media/video-interfaces.yaml#
        additionalProperties: false

        properties:
          bus-type:
            const: 1 # MIPI CSI-2 C-PHY
          data-lanes:
            items:
              - const: 0
          link-frequencies: true
          remote-endpoint: true

        required:
          - bus-type
          - data-lanes
          - link-frequencies

    required:
      - endpoint

required:
  - compatible
  - reg
  - clocks
  - avdd-supply
  - dovdd-supply
  - port

unevaluatedProperties: false

examples:
  - |
    #include <dt-bindings/gpio/gpio.h>
    #include <dt-bindings/media/video-interfaces.h>

    i2c {
        #address-cells = <1>;
        #size-cells = <0>;

        camera@10 {
            compatible = "sony,imx681";
            reg = <0x10>;
            clocks = <&camera_clk>;
            avdd-supply = <&camera_avdd>;
            dovdd-supply = <&camera_dovdd>;
            reset-gpios = <&gpio 10 GPIO_ACTIVE_LOW>;

            port {
                imx681_ep: endpoint {
                    bus-type = <MEDIA_BUS_TYPE_CSI2_CPHY>;
                    data-lanes = <0>;
                    link-frequencies = /bits/ 64 <1203000000>;
                    remote-endpoint = <&csi_in>;
                };
            };
        };
    };
...
```

## Documentation/devicetree/bindings/media/qcom,venus-common.yaml
```yaml
# SPDX-License-Identifier: (GPL-2.0 OR BSD-2-Clause)
%YAML 1.2
---
$id: http://devicetree.org/schemas/media/qcom,venus-common.yaml#
$schema: http://devicetree.org/meta-schemas/core.yaml#

title: Qualcomm SoC Venus Video Encode and Decode Accelerators Common Properties

maintainers:
  - Stanimir Varbanov <stanimir.k.varbanov@gmail.com>
  - Vikash Garodia <quic_vgarodia@quicinc.com>

description: |
  The Venus IP is a video encode and decode accelerator present
  on Qualcomm platforms

properties:
  reg:
    maxItems: 1

  clocks:
    minItems: 3
    maxItems: 7

  clock-names:
    minItems: 3
    maxItems: 7

  firmware-name:
    maxItems: 1

  interrupts:
    maxItems: 1

  iommus:
    minItems: 1
    maxItems: 20

  memory-region:
    maxItems: 1

  power-domains:
    minItems: 1
    maxItems: 4

  power-domain-names:
    minItems: 1
    maxItems: 4

  '#address-cells':
    const: 1

  '#size-cells':
    const: 1

  dma-ranges:
    maxItems: 1

  non-pixel:
    type: object
    description:
      Context bank for VPU non-pixel buffers, including compressed and internal buffers.
    additionalProperties: false

    properties:
      iommus:
        maxItems: 1
      iommu-ranges:
        maxItems: 1
    required:
      - iommus
      - iommu-ranges

  pixel:
    type: object
    description:
      Context bank for VPU pixel buffers containing uncompressed video data.
    additionalProperties: false

    properties:
      iommus:
        maxItems: 1
    required:
      - iommus

  video-firmware:
    type: object
    description:
      Context bank for the VPU firmware processing domain.
    additionalProperties: false

    properties:
      iommus:
        maxItems: 1
    required:
      - iommus

  secure-non-pixel:
    type: object
    description:
      Context bank for VPU secure non-pixel buffers.
    additionalProperties: false

    properties:
      iommus:
        maxItems: 1
      iommu-ranges:
        maxItems: 1
    required:
      - iommus
      - iommu-ranges

  secure-pixel:
    type: object
    description:
      Context bank for VPU secure pixel buffers containing uncompressed video data.
    additionalProperties: false

    properties:
      iommus:
        maxItems: 1
    required:
      - iommus

  secure-bitstream:
    type: object
    description:
      Context bank for VPU secure bitstream buffers containing compressed video data.
    additionalProperties: false

    properties:
      iommus:
        maxItems: 1
    required:
      - iommus

required:
  - reg
  - clocks
  - clock-names
  - interrupts
  - memory-region
  - power-domains

oneOf:
  - required:
      - iommus
  - required:
      - '#address-cells'
      - '#size-cells'
      - dma-ranges
      - non-pixel
      - pixel

additionalProperties: true
```

## Documentation/devicetree/bindings/sound/qcom,wsa8840.yaml
```yaml
# SPDX-License-Identifier: (GPL-2.0-only OR BSD-2-Clause)
%YAML 1.2
---
$id: http://devicetree.org/schemas/sound/qcom,wsa8840.yaml#
$schema: http://devicetree.org/meta-schemas/core.yaml#

title: Qualcomm WSA8840/WSA8845/WSA8845H smart speaker amplifier

maintainers:
  - Krzysztof Kozlowski <krzk@kernel.org>
  - Srinivas Kandagatla <srinivas.kandagatla@linaro.org>

description:
  WSA884X is a family of Qualcomm Aqstic smart speaker amplifiers using
  SoundWire digital audio interface.

allOf:
  - $ref: dai-common.yaml#

properties:
  compatible:
    const: sdw20217020400

  reg:
    maxItems: 1

  powerdown-gpios:
    description: Powerdown/Shutdown line to use (pin SD_N)
    maxItems: 1

  reset-gpios:
    description: Powerdown/Shutdown line to use (pin SD_N)
    maxItems: 1

  qcom,port-mapping:
    description: |
      Specifies static port mapping between slave and master ports.
      In the order of slave port index.
    $ref: /schemas/types.yaml#/definitions/uint32-array
    minItems: 6
    maxItems: 6

  qcom,enable-cps:
    type: boolean
    description: Enable the dedicated CPS SoundWire source DAI on data port 6.

  qcom,cps-offset1:
    $ref: /schemas/types.yaml#/definitions/uint32
    maximum: 255
    description: |
      Slave-only SoundWire DP6 OffsetCtrl1 override for CPS. This does not
      change the physical master-port schedule selected by qcom,port-mapping.

  qcom,visense-channel-mask:
    $ref: /schemas/types.yaml#/definitions/uint32
    minimum: 1
    maximum: 255
    description: |
      Native WSA data-port-5 channel-enable mask for the VISENSE protection
      sidechain. If absent, the codec default is used.

  '#sound-dai-cells':
    enum: [0, 1]
    description: |
      Zero selects the legacy single speaker-playback DAI. With one cell,
      DAI 0 is speaker playback, DAI 1 is the render-coupled VISENSE
      protection-feedback sidechain, and DAI 2 is the dedicated CPS feedback
      sidechain when qcom,enable-cps is present.

  vdd-1p8-supply: true
  vdd-io-supply: true

required:
  - compatible
  - reg
  - '#sound-dai-cells'
  - vdd-1p8-supply
  - vdd-io-supply

oneOf:
  - required:
      - powerdown-gpios
  - required:
      - reset-gpios

unevaluatedProperties: false

examples:
  - |
    #include <dt-bindings/gpio/gpio.h>

    soundwire {
        #address-cells = <2>;
        #size-cells = <0>;

        speaker@0,1 {
            compatible = "sdw20217020400";
            reg = <0 1>;
            pinctrl-names = "default";
            pinctrl-0 = <&spkr_2_sd_n_active>;
            powerdown-gpios = <&lpass_tlmm 18 GPIO_ACTIVE_LOW>;
            #sound-dai-cells = <1>;
            sound-name-prefix = "SpkrRight";
            vdd-1p8-supply = <&vreg_l15b_1p8>;
            vdd-io-supply = <&vreg_l3g_1p2>;
        };
    };
```
