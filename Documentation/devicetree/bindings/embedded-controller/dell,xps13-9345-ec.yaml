## Documentation/devicetree/bindings/embedded-controller/dell,xps13-9345-ec.yaml
```yaml
# SPDX-License-Identifier: (GPL-2.0-only OR BSD-2-Clause)
%YAML 1.2
---
$id: http://devicetree.org/schemas/embedded-controller/dell,xps13-9345-ec.yaml#
$schema: http://devicetree.org/meta-schemas/core.yaml#

title: Dell XPS 13 9345 Embedded Controller

maintainers:
  - Aleksandrs Vinarskis <alex@vinarskis.com>

description:
  The Dell XPS 13 9345 has an Embedded Controller (EC) which handles thermal and power
  management. It is communicating with SoC over multiple i2c busses. Particular driver
  is for EC subsystem that handles fan speed control, thermal shutdown, peripherals
  supply including trackpad, touch-row, display.

properties:
  compatible:
    const: dell,xps13-9345-ec

  reg:
    const: 0x3b

  interrupts:
    maxItems: 1

  io-channels:
    description:
      ADC channels connected to the 7 onboard thermistors on PMK8550.
      EC requires frequent thermal readings of these channels to perform
      automated fan speed control.
    items:
      - description: ADC channel for sys_therm0
      - description: ADC channel for sys_therm1
      - description: ADC channel for sys_therm2
      - description: ADC channel for sys_therm3
      - description: ADC channel for sys_therm4
      - description: ADC channel for sys_therm5
      - description: ADC channel for sys_therm6

  io-channel-names:
    items:
      - const: sys_therm0
      - const: sys_therm1
      - const: sys_therm2
      - const: sys_therm3
      - const: sys_therm4
      - const: sys_therm5
      - const: sys_therm6

required:
  - compatible
  - reg
  - interrupts
  - io-channels
  - io-channel-names

additionalProperties: false

examples:
  - |+
    #include <dt-bindings/interrupt-controller/irq.h>
    #include <dt-bindings/iio/qcom,spmi-adc7-pm8350.h>
    i2c {
        #address-cells = <1>;
        #size-cells = <0>;

        embedded-controller@3b {
            compatible = "dell,xps13-9345-ec";
            reg = <0x3b>;
            interrupts-extended = <&tlmm 66 IRQ_TYPE_LEVEL_LOW>;

            io-channels = <&pmk8550_vadc PM8350_ADC7_GPIO3_100K_PU(1)>,
                          <&pmk8550_vadc PM8350_ADC7_GPIO4_100K_PU(1)>,
                          <&pmk8550_vadc PM8350_ADC7_AMUX_THM1_100K_PU(1)>,
                          <&pmk8550_vadc PM8350_ADC7_AMUX_THM2_100K_PU(1)>,
                          <&pmk8550_vadc PM8350_ADC7_AMUX_THM3_100K_PU(1)>,
                          <&pmk8550_vadc PM8350_ADC7_AMUX_THM4_100K_PU(1)>,
                          <&pmk8550_vadc PM8350_ADC7_AMUX_THM5_100K_PU(1)>;
            io-channel-names = "sys_therm0", "sys_therm1", "sys_therm2",
                               "sys_therm3", "sys_therm4", "sys_therm5",
                               "sys_therm6";
        };
    };
...
```

## Documentation/devicetree/bindings/embedded-controller/qcom,x1e-it8987-ec.yaml
```yaml
# SPDX-License-Identifier: (GPL-2.0-only OR BSD-2-Clause)
%YAML 1.2
---
$id: http://devicetree.org/schemas/platform/qcom,x1e-it8987-ec.yaml#
$schema: http://devicetree.org/meta-schemas/core.yaml#

title: Qualcomm Embedded Controller on IT8987 chip.

maintainers:
  - Maya Matuszczyk <maccraft123mc@gmail.com>

description:
  Most x1e80100 laptops have an EC running on IT8987 MCU chip. The EC controls
  minor functions, like fans, power LED, and on some laptops it also handles
  keyboard hotkeys.

properties:
  compatible:
    oneOf:
      - const: qcom,x1e-it8987-ec
      - items:
        - const: lenovo,yoga-slim7x-ec
        - const: qcom,x1e-it8987-ec

  reg:
    const: 0x76

  interrupts:
    maxItems: 1

required:
  - compatible
  - reg
  - interrupts

additionalProperties: false

examples:
  - |
    #include <dt-bindings/interrupt-controller/irq.h>
    i2c {
        #address-cells = <1>;
        #size-cells = <0>;

        embedded-controller@76 {
            compatible = "lenovo,yoga-slim7x-ec", "qcom,x1e-it8987-ec";
            reg = <0x76>;

            interrupts-extended = <&tlmm 66 IRQ_TYPE_LEVEL_HIGH>;
        };
    };
...
```

## Documentation/devicetree/bindings/media/qcom,sm8350-venus.yaml
```yaml
# SPDX-License-Identifier: (GPL-2.0 OR BSD-2-Clause)
%YAML 1.2
---
$id: http://devicetree.org/schemas/media/qcom,sm8350-venus.yaml#
$schema: http://devicetree.org/meta-schemas/core.yaml#

title: Qualcomm SM8350 Venus video encode and decode accelerators

maintainers:
  - Konrad Dybcio <konradybcio@kernel.org>

description: |
  The Venus Iris2 IP is a video encode and decode accelerator present
  on Qualcomm platforms

allOf:
  - $ref: qcom,venus-common.yaml#

properties:
  compatible:
    enum:
      - qcom,sc8280xp-venus
      - qcom,sm8350-venus

  clocks:
    maxItems: 3

  clock-names:
    items:
      - const: iface
      - const: core
      - const: vcodec0_core

  resets:
    maxItems: 1

  reset-names:
    items:
      - const: core

  power-domains:
    maxItems: 3

  power-domain-names:
    items:
      - const: venus
      - const: vcodec0
      - const: mx

  interconnects:
    maxItems: 3

  interconnect-names:
    items:
      - const: cpu-cfg
      - const: video-mem
      - const: video-llcc

  operating-points-v2: true
  opp-table:
    type: object

  iommus:
    maxItems: 1

required:
  - compatible
  - power-domain-names
  - iommus

unevaluatedProperties: false

examples:
  - |
    #include <dt-bindings/interrupt-controller/arm-gic.h>
    #include <dt-bindings/clock/qcom,gcc-sm8350.h>
    #include <dt-bindings/clock/qcom,sm8350-videocc.h>
    #include <dt-bindings/interconnect/qcom,icc.h>
    #include <dt-bindings/interconnect/qcom,sm8350.h>
    #include <dt-bindings/power/qcom-rpmpd.h>

    venus: video-codec@aa00000 {
        compatible = "qcom,sm8350-venus";
        reg = <0x0aa00000 0x100000>;
        interrupts = <GIC_SPI 174 IRQ_TYPE_LEVEL_HIGH>;

        clocks = <&gcc GCC_VIDEO_AXI0_CLK>,
                 <&videocc VIDEO_CC_MVS0C_CLK>,
                 <&videocc VIDEO_CC_MVS0_CLK>;
        clock-names = "iface",
                      "core",
                      "vcodec0_core";

        resets = <&gcc GCC_VIDEO_AXI0_CLK_ARES>;
        reset-names = "core";

        power-domains = <&videocc MVS0C_GDSC>,
                        <&videocc MVS0_GDSC>,
                        <&rpmhpd SM8350_MX>;
        power-domain-names = "venus",
                             "vcodec0",
                             "mx";

        interconnects = <&gem_noc MASTER_APPSS_PROC QCOM_ICC_TAG_ACTIVE_ONLY
                         &config_noc SLAVE_VENUS_CFG QCOM_ICC_TAG_ACTIVE_ONLY>,
                        <&mmss_noc MASTER_VIDEO_P0 QCOM_ICC_TAG_ALWAYS
                         &mc_virt SLAVE_EBI1 QCOM_ICC_TAG_ALWAYS>,
                        <&mmss_noc MASTER_VIDEO_P0 QCOM_ICC_TAG_ALWAYS
                         &gem_noc SLAVE_LLCC QCOM_ICC_TAG_ALWAYS>;
        interconnect-names = "cpu-cfg",
                             "video-mem",
                             "video-llcc";

        operating-points-v2 = <&venus_opp_table>;
        iommus = <&apps_smmu 0x2100 0x400>;
        memory-region = <&pil_video_mem>;

        status = "disabled";
    };
```
