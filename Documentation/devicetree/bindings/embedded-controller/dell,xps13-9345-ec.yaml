## Documentation/devicetree/bindings/mfd/qcom,pm8008.yaml
```yaml
# SPDX-License-Identifier: GPL-2.0-only OR BSD-2-Clause
%YAML 1.2
---
$id: http://devicetree.org/schemas/mfd/qcom,pm8008.yaml#
$schema: http://devicetree.org/meta-schemas/core.yaml#

title: Qualcomm Technologies, Inc. PM8008 PMIC

maintainers:
  - Guru Das Srinagesh <quic_gurus@quicinc.com>

description: |
  Qualcomm Technologies, Inc. PM8008 is a dedicated camera PMIC that integrates
  all the necessary power management, housekeeping, and interface support
  functions into a single IC.

properties:
  compatible:
    const: qcom,pm8008

  reg:
    description:
      I2C slave address.

    maxItems: 1

  interrupts:
    maxItems: 1

    description: Parent interrupt.

  "#interrupt-cells":
    const: 2

    description: |
      The first cell is the IRQ number, the second cell is the IRQ trigger
      flag. All interrupts are listed in include/dt-bindings/mfd/qcom-pm8008.h.

  interrupt-controller: true

  "#address-cells":
    const: 2

  "#size-cells":
    const: 0

  reset-gpios:
    maxItems: 1

  vdd_l1_l2-supply:
    description: Input supply phandle of ldo1 and ldo2 regulators.

  vdd_l3_l4-supply:
    description: Input supply phandle of ldo3 and ldo4 regulators.

  vdd_l5-supply:
    description: Input supply phandle of ldo5 regulator.

  vdd_l6-supply:
    description: Input supply phandle of ldo6 regulator.

  vdd_l7-supply:
    description: Input supply phandle of ldo7 regulator.

patternProperties:
  "^gpio@0,[0-9a-f]+$":
    type: object

    description: |
      The GPIO peripheral. This node may be specified twice, one for each GPIO.

    properties:
      compatible:
        items:
          - const: qcom,pm8008-gpio
          - const: qcom,spmi-gpio

      reg:
        description: Peripheral offset and address of one of the two GPIO peripherals.
        maxItems: 1

      gpio-controller: true

      gpio-ranges:
        maxItems: 1

      interrupt-controller: true

      "#interrupt-cells":
        const: 2

      "#gpio-cells":
        const: 2

    required:
      - compatible
      - reg
      - gpio-controller
      - interrupt-controller
      - "#gpio-cells"
      - gpio-ranges
      - "#interrupt-cells"

    additionalProperties: false

  "^ldo[1-7]@[1],[0-9a-f]+$":
    type: object

    $ref: "/schemas/regulator/regulator.yaml#"

    description: PM8008 regulator peripherals of PM8008 regulator device.

    properties:
      compatible:
        const: qcom,pm8008-regulator

      reg:
        description: Peripheral offset and address of the ldo regulator.
        maxItems: 1

    required:
      - compatible
      - reg

    unevaluatedProperties: false

required:
  - compatible
  - reg
  - interrupts
  - "#address-cells"
  - "#size-cells"
  - "#interrupt-cells"
  - reset-gpios

additionalProperties: false

examples:
  - |
    #include <dt-bindings/mfd/qcom-pm8008.h>
    #include <dt-bindings/interrupt-controller/irq.h>
    #include <dt-bindings/gpio/gpio.h>
    qupv3_se13_i2c {
      #address-cells = <1>;
      #size-cells = <0>;
      pm8008i@8 {
        compatible = "qcom,pm8008";
        reg = <0x8>;
        #address-cells = <2>;
        #size-cells = <0>;
        interrupt-controller;
        #interrupt-cells = <2>;

        interrupt-parent = <&tlmm>;
        interrupts = <32 IRQ_TYPE_EDGE_RISING>;

        reset-gpios = <&pm8350c_gpios 4 GPIO_ACTIVE_LOW>;

        vdd_l1_l2-supply = <&vreg_s8b_1p2>;
        vdd_l3_l4-supply = <&vreg_s1b_1p8>;
        vdd_l5-supply = <&vreg_bob>;
        vdd_l6-supply = <&vreg_bob>;
        vdd_l7-supply = <&vreg_bob>;

        pm8008_gpios: gpio@0,c000 {
          compatible = "qcom,pm8008-gpio", "qcom,spmi-gpio";
          reg = <0x0 0xc000>;
          gpio-controller;
          gpio-ranges = <&pm8008_gpios 0 0 2>;
          #gpio-cells = <2>;
          interrupt-controller;
          #interrupt-cells = <2>;
        };

        ldo1@1,4000 {
          compatible = "qcom,pm8008-regulator";
          reg = <0x1 0x4000>;
          regulator-name = "pm8008_ldo1";
          regulator-min-microvolt = <950000>;
          regulator-max-microvolt = <1300000>;
        };
      };
    };

...
```

## Documentation/devicetree/bindings/phy/qcom,x1e80100-csi2-phy.yaml
```yaml
# SPDX-License-Identifier: (GPL-2.0 OR BSD-2-Clause)
%YAML 1.2
---
$id: http://devicetree.org/schemas/phy/qcom,x1e80100-csi2-phy.yaml#
$schema: http://devicetree.org/meta-schemas/core.yaml#

title: Qualcomm CSI2 PHY

maintainers:
  - Bryan O'Donoghue <bod@kernel.org>

description:
  Qualcomm MIPI CSI2 C-PHY/D-PHY combination PHY. Connects MIPI CSI2 sensors
  to Qualcomm's Camera CSI Decoder. The PHY supports both C-PHY and D-PHY
  modes.

properties:
  compatible:
    const: qcom,x1e80100-csi2-phy

  reg:
    maxItems: 1

  "#phy-cells":
    const: 1
    description:
      The single cell specifies the PHY operating mode.
      See include/dt-bindings/phy/phy-qcom-mipi-csi2.h for valid values.

  clocks:
    maxItems: 2

  clock-names:
    items:
      - const: core
      - const: timer

  interrupts:
    maxItems: 1

  operating-points-v2:
    maxItems: 1

  power-domains:
    items:
      - description: MXC or MXA voltage rail
      - description: MMCX voltage rail

  power-domain-names:
    items:
      - const: mx
      - const: mmcx

  vdda-0p9-supply:
    description: Phandle to a 0.9V regulator supply to a PHY.

  vdda-1p2-supply:
    description: Phandle to 1.2V regulator supply to a PHY.

required:
  - compatible
  - reg
  - "#phy-cells"
  - clocks
  - clock-names
  - interrupts
  - operating-points-v2
  - power-domains
  - power-domain-names
  - vdda-0p9-supply
  - vdda-1p2-supply

additionalProperties: false

examples:
  - |
    #include <dt-bindings/interrupt-controller/arm-gic.h>
    #include <dt-bindings/clock/qcom,x1e80100-camcc.h>
    #include <dt-bindings/clock/qcom,x1e80100-gcc.h>
    #include <dt-bindings/phy/phy-qcom-mipi-csi2.h>
    #include <dt-bindings/power/qcom,rpmhpd.h>

    csiphy4: csiphy@ace4000 {
        compatible = "qcom,x1e80100-csi2-phy";
        reg = <0x0ace4000 0x2000>;
        #phy-cells = <1>;

        clocks = <&camcc CAM_CC_CSIPHY0_CLK>,
                 <&camcc CAM_CC_CSI0PHYTIMER_CLK>;
        clock-names = "core",
                      "timer";

        operating-points-v2 = <&csiphy_opp_table>;

        interrupts = <GIC_SPI 477 IRQ_TYPE_EDGE_RISING>;

        power-domains = <&rpmhpd RPMHPD_MX>,
                        <&rpmhpd RPMHPD_MMCX>;
        power-domain-names = "mx",
                             "mmcx";

        vdda-0p9-supply = <&vreg_l2c_0p8>;
        vdda-1p2-supply = <&vreg_l1c_1p2>;
    };

    csiphy_opp_table: opp-table {
        compatible = "operating-points-v2";

        opp-300000000 {
            opp-hz = /bits/ 64 <300000000>;
            required-opps = <&rpmhpd_opp_low_svs_d1>,
                            <&rpmhpd_opp_low_svs_d1>;
        };

        opp-400000000 {
            opp-hz = /bits/ 64 <400000000>;
            required-opps = <&rpmhpd_opp_low_svs>,
                            <&rpmhpd_opp_low_svs>;
        };

        opp-480000000 {
            opp-hz = /bits/ 64 <480000000>;
            required-opps = <&rpmhpd_opp_low_svs>,
                            <&rpmhpd_opp_low_svs>;
        };
    };

    isp@acb7000 {
        phys = <&csiphy4 PHY_QCOM_CSI2_MODE_DPHY>;
    };
```

## Documentation/devicetree/bindings/phy/qcom,x1e80100-mipi-csi2-combo-phy.yaml
```yaml
# SPDX-License-Identifier: (GPL-2.0 OR BSD-2-Clause)
%YAML 1.2
---
$id: http://devicetree.org/schemas/phy/qcom,x1e80100-mipi-csi2-combo-phy.yaml#
$schema: http://devicetree.org/meta-schemas/core.yaml#

title: Qualcomm MIPI CSI2 Combo PHY

maintainers:
  - Bryan O'Donoghue <bod@kernel.org>

description:
  Qualcomm MIPI CSI2 C-PHY/D-PHY combination PHY. Connects MIPI CSI2 sensors
  to Qualcomm's Camera CSI Decoder. The PHY supports both C-PHY and D-PHY
  modes.

properties:
  compatible:
    const: qcom,x1e80100-mipi-csi2-combo-phy

  reg:
    maxItems: 1

  "#phy-cells":
    const: 0

  clocks:
    maxItems: 4

  clock-names:
    items:
      - const: camnoc_axi
      - const: cpas_ahb
      - const: csiphy
      - const: csiphy_timer

  interrupts:
    maxItems: 1

  power-domains:
    maxItems: 1

  vdda-0p8-supply:
    description: Phandle to a 0.8V regulator supply to a PHY.

  vdda-1p2-supply:
    description: Phandle to 1.2V regulator supply to a PHY.

  phy-type:
    description: D-PHY or C-PHY mode
    enum: [ 10, 11 ]
    $ref: /schemas/types.yaml#/definitions/uint32

required:
  - compatible
  - reg
  - "#phy-cells"
  - clocks
  - clock-names
  - vdda-0p8-supply
  - vdda-1p2-supply
  - phy-type

additionalProperties: false

examples:
  - |
    #include <dt-bindings/interrupt-controller/arm-gic.h>
    #include <dt-bindings/clock/qcom,x1e80100-camcc.h>
    #include <dt-bindings/clock/qcom,x1e80100-gcc.h>
    #include <dt-bindings/phy/phy.h>

    csiphy0: csiphy@ace4000 {
        compatible = "qcom,x1e80100-mipi-csi2-combo-phy";
        reg = <0x0ace4000 0x2000>;
        #phy-cells = <0>;

        clocks = <&camcc CAM_CC_CAMNOC_AXI_RT_CLK>,
                 <&camcc CAM_CC_CPAS_AHB_CLK>,
                 <&camcc CAM_CC_CSIPHY0_CLK>,
                 <&camcc CAM_CC_CSI0PHYTIMER_CLK>;
        clock-names = "camnoc_axi",
                      "cpas_ahb",
                      "csiphy",
                      "csiphy_timer";

        interrupts = <GIC_SPI 477 IRQ_TYPE_EDGE_RISING>;

        power-domains = <&camcc CAM_CC_TITAN_TOP_GDSC>;

        vdda-0p8-supply = <&vreg_l2c_0p8>;
        vdda-1p2-supply = <&vreg_l1c_1p2>;

        phy-type = <PHY_TYPE_DPHY>;
    };
```

## Documentation/devicetree/bindings/power/limits/qcom,spel.yaml
```yaml
# SPDX-License-Identifier: (GPL-2.0-only OR BSD-2-Clause)
%YAML 1.2
---
$id: http://devicetree.org/schemas/power/limits/qcom,spel.yaml#
$schema: http://devicetree.org/meta-schemas/core.yaml#

title: Qualcomm SoC Power and Electrical Limits (SPEL)

maintainers:
  - Manaf Meethalavalappu Pallikunhi <manaf.pallikunhi@oss.qualcomm.com>

description:
  The Qualcomm SPEL (SoC Power and Electrical Limits) provides hardware-based
  power monitoring and limiting capabilities for various power domains in
  Qualcomm SoCs.

properties:
  compatible:
    const: qcom,glymur-spel

  reg:
    maxItems: 3

  reg-names:
    items:
      - const: config
      - const: constraints
      - const: nodes

required:
  - compatible
  - reg
  - reg-names

additionalProperties: false

examples:
  - |
    power-limits@ef3b000 {
        compatible = "qcom,glymur-spel";
        reg = <0x0ef3b000 0x1000>,
              <0x0ef3d000 0x1000>,
              <0x0ef3e000 0x1000>;
        reg-names = "config",
                    "constraints",
                    "nodes";
    };
```

## Documentation/devicetree/bindings/regulator/dummy-consumer.yaml
```yaml
# SPDX-License-Identifier: GPL-2.0-only OR BSD-2-Clause
%YAML 1.2
---
$id: http://devicetree.org/schemas/regulator/dummy-consumer.yaml#
$schema: http://devicetree.org/meta-schemas/core.yaml#

title: Dummy regulator consumer

maintainers:
  - Aleksandrs Vinarskis <alex.vinarskis@gmail.com>

description: |
  Simple dummy regulator consumer node for devices which are not/cannot be
  described in the devicetree, and do not need to be powered on during
  suspend. A power-friendly alternative to leaving regulator without
  consumer with 'regulator-always-on' property.

properties:
  compatible:
    enum:
      - regulator-dummy-consumer

  vdd-supply:
    description: Regulator to control
    $ref: /schemas/types.yaml#/definitions/phandle

required:
  - compatible
  - vdd-supply

additionalProperties: false

examples:
  - |
    integrated-usb-camera {
      compatible = "regulator-dummy-consumer";

      vdd-supply = <&vdd>;
    };
```

## Documentation/devicetree/bindings/usb/parade,ps8830.yaml
```yaml
# SPDX-License-Identifier: GPL-2.0-only OR BSD-2-Clause
%YAML 1.2
---
$id: http://devicetree.org/schemas/usb/parade,ps8830.yaml#
$schema: http://devicetree.org/meta-schemas/core.yaml#

title: Parade PS8830 USB and DisplayPort Retimer

maintainers:
  - Abel Vesa <abel.vesa@linaro.org>

properties:
  compatible:
    enum:
      - parade,ps8830

  reg:
    maxItems: 1

  clocks:
    items:
      - description: XO Clock

  clock-names:
    items:
      - const: xo

  reset-gpios:
    maxItems: 1

  vdd15-supply:
    description: power supply (1.5V)

  vdd18-supply:
    description: power supply (1.8V)

  vdd33-supply:
    description: power supply (3.3V)

  orientation-switch: true
  retimer-switch: true

  ports:
    $ref: /schemas/graph.yaml#/properties/ports
    properties:
      port@0:
        $ref: /schemas/graph.yaml#/properties/port
        description: Super Speed (SS) Output endpoint to the Type-C connector

      port@1:
        $ref: /schemas/graph.yaml#/$defs/port-base
        description: Super Speed (SS) Input endpoint from the Super-Speed PHY
        unevaluatedProperties: false

      port@2:
        $ref: /schemas/graph.yaml#/properties/port
        description:
          Sideband Use (SBU) AUX lines endpoint to the Type-C connector for the purpose of
          handling altmode muxing and orientation switching.

required:
  - compatible
  - reg

allOf:
  - $ref: usb-switch.yaml#

additionalProperties: false

examples:
  - |
    #include <dt-bindings/gpio/gpio.h>

    i2c {
        #address-cells = <1>;
        #size-cells = <0>;

        typec-mux@8 {
            compatible = "parade,ps8830";
            reg = <0x8>;

            vdd15-supply = <&vreg_rtmr_1p15>;
            vdd18-supply = <&vreg_rtmr_1p8>;
            vdd33-supply = <&vreg_rtmr_3p3>;

            reset-gpios = <&pm8550_gpios 10 GPIO_ACTIVE_HIGH>;

            retimer-switch;
            orientation-switch;

            ports {
                #address-cells = <1>;
                #size-cells = <0>;

                port@0 {
                    reg = <0>;
                    usb_con_ss: endpoint {
                        remote-endpoint = <&typec_con_ss>;
                    };
                };
                port@1 {
                    reg = <1>;
                    phy_con_ss: endpoint {
                        remote-endpoint = <&usb_phy_ss>;
                        data-lanes = <3 2 1 0>;
                    };
                };
                port@2 {
                    reg = <2>;
                    usb_con_sbu: endpoint {
                        remote-endpoint = <&typec_dp_aux>;
                    };
                };
            };
        };
    };
...
```
